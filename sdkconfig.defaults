## sdkconfig.defaults
```kconfig
CONFIG_ESPTOOLPY_FLASHSIZE_4MB=y
CONFIG_PARTITION_TABLE_CUSTOM=y
CONFIG_ETH_USE_OPENETH=y
CONFIG_HTTPD_WS_SUPPORT=y
CONFIG_ESP_SYSTEM_PANIC_GDBSTUB=y
CONFIG_ESP_COREDUMP_ENABLE_TO_UART=y
CONFIG_FREERTOS_USE_TRACE_FACILITY=y
```
